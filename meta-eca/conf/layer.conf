## meta-eca/conf/layer.conf
```bitbake
BBPATH ?= ""
# We add conf directory to BBPATH
BBPATH .= ":${LAYERDIR}"

# We have a recipes directory containing .bb and .bbappend files, add to BBFILES
BBFILES += "${LAYERDIR}/recipes-*/*/*.bb \
            ${LAYERDIR}/recipes-*/*/*.bbappend"

BBFILE_COLLECTIONS += "eca"
BBFILE_PATTERN_eca := "^${LAYERDIR}/"
BBFILE_PRIORITY_eca = "7"

# Define a similar VARIABLE to COREBASE in order to get a reference to
# top directory easily
ECA_COREBASE := '${@os.path.normpath("${LAYERDIR}/../")}'
```
